/*@!Encoding:936*/
includes
{
  
}

variables
{
  msTimer NM_wakeup_message_timer_100;  // 周期发送网络管理唤醒报文
  message 0x600 NM_wakeup_message = {dlc=8};  
  
  // 故障注入相关的计时器
  msTimer BCM_1_miss_time;
  msTimer SAS_1_miss_time;
  msTimer VCU_P_5_miss_time;
  msTimer YAS_1_miss_time;
}

// 唤醒报文定时器回调
on timer NM_wakeup_message_timer_100
{
  output(NM_wakeup_message); 
  setTimer(NM_wakeup_message_timer_100,100);
}

// 系统变量触发：ECU 唤醒
On sysvar_update sysvar::StressTest::ECU_WakeUp
{
   setTimer(NM_wakeup_message_timer_100,100);
}

// 系统变量触发：ECU 休眠
On sysvar_update sysvar::StressTest::ECU_Sleep
{
  cancelTimer (NM_wakeup_message_timer_100);
}

// 网关节点仿真控制
on sysvar_update sysvar::StressTest::GW_node_control
{
  if (@this == 1)
  {
     ILControlStop();   // 停止发送该节点所有报文
  }
  else
  {
    ILControlStart();   // 开启该节点报文仿真
  }
}

// 故障恢复计时器 (BCM)
on timer BCM_1_miss_time
{
  @ sysvar::Input::Message_missing::BCM_1_0x245 = 0;
}

// 故障恢复计时器 (SAS)
on timer SAS_1_miss_time
{
  @ sysvar::Input::Message_missing::SAS_1_0xC4 = 0;
}

// 初始化
on preStart
{
   set_input_valid();
}

// 具体的故障注入逻辑 (报文丢失)
on sysvar_update sysvar::Input::Message_missing::BCM_1_0x245
{
  if(@this == 1)
  {
    ILFaultInjectionDisableMsg(CGW_BCM_1);
    setTimer(BCM_1_miss_time, @ sysvar::Input::Message_missing::BCM_1_0x245_miss_time);
  }
  else
  { 
    ILFaultInjectionEnableMsg(CGW_BCM_1);
  } 
}

// 输入有效性初始化
set_input_valid()
{
  $CGW_VCU_P_5::VCU_VehSpd = 0; // 车速初始化
  $CGW_VCU_P_5::VCU_ActGear = 11; // 档位初始化 (P档)
  $CGW_SAS_1::SAS_SteeringAngle = 0; // 转角初始化
  $BCM_12V_BattVolt=12.5; // 电压初始化
}
