/*@!Encoding:936*/
includes
{
}

variables
{
  message SAS_1 SAS;  
  msTimer SAS_10;
  
  message VCU_P_5 VCU;  
  msTimer VCU_10;
  
  message YAS_1 YAS;
  msTimer YAS_20;
}

on start {
  // 初始化定时器：100ms/200ms 后开始循环
  setTimer(SAS_10,100);
  setTimer(VCU_10,100);
  setTimer(YAS_20,200);
}

// 偏航角信号仿真 (20ms周期)
on timer YAS_20
{
  // 从系统变量读取 rad 并转换为 deg 发送到总线
  YAS.YAS_YawRate.phys = @ sysvar::Input::BSD::YAS_YawRate * 57.3;
  output(YAS);
  setTimer(YAS_20,20);
}

// 转向角信号仿真 (10ms周期)
on timer SAS_10
{
  SAS.SAS_SteeringAngle.phys = @ sysvar::Input::BSD::SAS_SteeringAngle * 57.3 ;
  output(SAS);
  setTimer(SAS_10,10);
}

// 车速与档位仿真 (10ms周期)
on timer VCU_10
{
    VCU.VCU_VehSpd.phys = @ sysvar::Input::BSD::VCU_VehSpd;
    
    // 档位逻辑转换
    if (@ sysvar::Input::BSD::VCU_Gear == 0x01)  // D档
    {
      VCU.VCU_Gear = 0x01;
    }
    else if(@ sysvar::Input::BSD::VCU_Gear == 0x02)   // R档
    {
      VCU.VCU_Gear= 0x09;
    }
    else if(@ sysvar::Input::BSD::VCU_Gear == 0x03)   // P档
    {
      VCU.VCU_Gear = 0x0B;
    }
  
  output(VCU);
  setTimer(VCU_10,10);
}
